## usgm-05/firmware/main/Kconfig.projbuild
```kconfig
menu "USGM-05 experimental settings"
    config USGM_AP_PASSWORD
        string "Wi-Fi SoftAP password (8 to 63 chars; change before field use)"
        default "USGM05-DEMO-CHANGE"
    config USGM_WOKWI_MODE
        bool "Wokwi HX711 simulation ONLY (not for physical hardware)"
        default n
        help
            Use Wokwi-GUEST station instead of physical device SoftAP.
            Initialize the virtual 5kg HX711 using synthetic 0..2100 counts.
            Virtual measurements must never be claimed as real hardware results.
endmenu
```

## usgm-05/firmware/sdkconfig.defaults
```kconfig
CONFIG_IDF_TARGET="esp32c3"
CONFIG_ESP_WIFI_SOFTAP_SUPPORT=y
CONFIG_ESP_HTTP_SERVER_ENABLE=y
CONFIG_PARTITION_TABLE_CUSTOM=y
CONFIG_PARTITION_TABLE_CUSTOM_FILENAME="partitions.csv"
CONFIG_PARTITION_TABLE_FILENAME="partitions.csv"
CONFIG_ESPTOOLPY_FLASHSIZE_4MB=y
```
